; list here the registers and constants you want to include in the FF core dictionar
; The parameters are
; constant value, word name, word flags (inline=0x20)

; Ports
m_const DDRB,ddrb,0
m_const DDRC,ddrc,0
m_const DDRD,ddrd,0
m_const PINB,pinb,0
m_const PINC,pinc,0
m_const PIND,pind,0
m_const PORTB,portb,0
m_const PORTC,portc,0
m_const PORTD,portd,0

; Timers
m_const OCR0A,ocr0a,0
m_const OCR0B,ocr0b,0
m_const OCR1AL,ocr1al,0
m_const OCR1BL,ocr1bl,0
m_const OCR2A,ocr2a,0
m_const OCR2B,ocr2b,0
m_const TCCR0A,tccr0a,0
m_const TCCR0B,tccr0b,0
m_const TCCR1A,tccr1a,0
m_const TCCR1B,tccr1b,0
m_const TCCR2A,tccr2a,0
m_const TCCR2B,tccr2b,0
m_const TIMSK0,timsk0,0
m_const TIMSK1,timsk1,0
m_const TIMSK2,timsk2,0
